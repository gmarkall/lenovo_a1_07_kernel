## drivers/input/sensor/Kconfig
```kconfig
#
# Touchscreen driver configuration
#
menuconfig SENSOR
	bool "sensor supports"
	help
	  Say Y here, and a list of supported touchscreens will be displayed.
	  This option doesn't affect the kernel.

	  If unsure, say Y.

if SENSOR

config CM3217_LIGHTSENSOR
	bool "cm3217 lightsensor support"
	depends on SENSOR
	default y
	help
	  support the use of cm3217 lightsensor
	  
config ADXL345_GSENSOR_MODULE 
	bool "Gsensor support"
	depends on SENSOR
	default y
	
config GSENSOR_AUTO_ROTATION_TEST
	bool "Enable auto rotation test by itself"
	depends on ADXL345_GSENSOR_MODULE
	help
	  Say Y here to enable support for auto rotation testing.



endif
```

## drivers/input/sensor/vibrator/Kconfig
```kconfig
menuconfig VIBRATOR
	bool "VIBRATOR support"
	default y
	help
	  support the use of vibrator

if VIBRATOR

config CL1_VIBRATOR
	bool "CL1 vibrator support"
	depends on VIBRATOR
	default y
	help
	  support for vibrator

endif
```

## net/rfkill_fxn/Kconfig
```kconfig
#
# RF switch subsystem configuration
#
menuconfig RFKILL
	tristate "RF switch subsystem support"
	help
	  Say Y here if you want to have control over RF switches
	  found on many WiFi and Bluetooth cards.

	  To compile this driver as a module, choose M here: the
	  module will be called rfkill.

config RFKILL_PM
	bool "Power off on suspend"
	depends on RFKILL && PM
	default n

config RFKILL_WIFI
	bool "Power control on Wi-Fi"
	depends on RFKILL
	default y

config RFKILL_GPS
	bool "Power control on GPS"
	depends on RFKILL
	default y

config RFKILL_BT
	bool "Power control on Bluetooth"
	depends on RFKILL
	default y

config RFKILL_INPUT
	tristate "Input layer to RF switch connector"
	depends on RFKILL && INPUT
	help
	  Say Y here if you want kernel automatically toggle state
	  of RF switches on and off when user presses appropriate
	  button or a key on the keyboard. Without this module you
	  need a some kind of userspace application to control
	  state of the switches.

	  To compile this driver as a module, choose M here: the
	  module will be called rfkill-input.

# LED trigger support
config RFKILL_LEDS
	bool
	depends on RFKILL && LEDS_TRIGGERS
	default y

config WIRELESS_BCM4329
	bool "Enable Broadcom 4329 3in1 chip"
	depends on RFKILL
	default y
	
config RFKILL_WIFI_BT_DEFAULT_ON
	bool "Set WIFI BT module default power on"
	depends on RFKILL && (RFKILL_WIFI || RFKILL_BT)
	default y
```
